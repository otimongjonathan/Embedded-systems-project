#include "oled.h"
#include "driver/i2c_master.h"
#include "freertos/FreeRTOS.h"
#include "freertos/task.h"
#include <string.h>
#include <stdio.h>

#define OLED_ADDR 0x3C

static i2c_master_bus_handle_t bus_handle;
static i2c_master_dev_handle_t dev_handle;

// A basic 5x7 font for ASCII characters 32-122
static const uint8_t font5x7[][5] = {
    {0x00, 0x00, 0x00, 0x00, 0x00}, // (space)
    {0x00, 0x00, 0x5F, 0x00, 0x00}, // !
    {0x00, 0x07, 0x00, 0x07, 0x00}, // "
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    {0x44, 0x64, 0x54, 0x4C, 0x44}, // z
};

static void oled_send_cmd(uint8_t cmd) {
    uint8_t buf[2] = {0x00, cmd};
    i2c_master_transmit(dev_handle, buf, 2, 1000);
}

static void oled_send_data(uint8_t *data, size_t len) {
    uint8_t buf[129];
    buf[0] = 0x40;
    memcpy(&buf[1], data, len);
    i2c_master_transmit(dev_handle, buf, len + 1, 1000);
}

static void oled_set_cursor(uint8_t page, uint8_t col) {
    oled_send_cmd(0xB0 | page);
    oled_send_cmd(0x00 | (col & 0x0F));
    oled_send_cmd(0x10 | ((col >> 4) & 0x0F));
}

static void oled_clear(void) {
    uint8_t zeros[128] = {0};
    for (int i = 0; i < 8; i++) {
        oled_set_cursor(i, 0);
        oled_send_data(zeros, 128);
    }
}

// Draw text with double width (2x scale) to make it massive
static void oled_draw_string_2x(uint8_t page, uint8_t col, const char *str) {
    oled_set_cursor(page, col);
    while (*str) {
        char c = *str++;
        if (c < 32 || c > 122) c = 32;
        uint8_t idx = c - 32;
        uint8_t buffer[12];
        
        // Duplicate each column to double the width
        for (int i = 0; i < 5; i++) {
            buffer[i*2] = font5x7[idx][i];
            buffer[i*2+1] = font5x7[idx][i];
        }
        buffer[10] = 0x00; // Space
        buffer[11] = 0x00;
        
        oled_send_data(buffer, 12);
    }
}

void oled_init(void) {
    i2c_master_bus_config_t i2c_mst_config = {
        .clk_source = I2C_CLK_SRC_DEFAULT,
        .i2c_port = I2C_NUM_0,
        .scl_io_num = 22,
        .sda_io_num = 21,
        .glitch_ignore_cnt = 7,
        .flags.enable_internal_pullup = true,
    };
    i2c_new_master_bus(&i2c_mst_config, &bus_handle);

    i2c_device_config_t dev_cfg = {
        .dev_addr_length = I2C_ADDR_BIT_LEN_7,
        .device_address = OLED_ADDR,
        .scl_speed_hz = 400000,
    };
    i2c_master_bus_add_device(bus_handle, &dev_cfg, &dev_handle);

    vTaskDelay(pdMS_TO_TICKS(100));
    
    oled_send_cmd(0xAE); oled_send_cmd(0x20); oled_send_cmd(0x00);
    oled_send_cmd(0xB0); oled_send_cmd(0xC8); oled_send_cmd(0x00);
    oled_send_cmd(0x10); oled_send_cmd(0x40); oled_send_cmd(0x81);
    oled_send_cmd(0xFF); oled_send_cmd(0xA1); oled_send_cmd(0xA6);
    oled_send_cmd(0xA8); oled_send_cmd(0x3F); oled_send_cmd(0xA4);
    oled_send_cmd(0xD3); oled_send_cmd(0x00); oled_send_cmd(0xD5);
    oled_send_cmd(0xF0); oled_send_cmd(0xD9); oled_send_cmd(0x22);
    oled_send_cmd(0xDA); oled_send_cmd(0x12); oled_send_cmd(0xDB);
    oled_send_cmd(0x20); oled_send_cmd(0x8D); oled_send_cmd(0x14);
    oled_send_cmd(0xAF);
    
    oled_clear();
}

void oled_update_idle(int occupancy) {
    oled_clear();
    (void)occupancy;
    oled_draw_string_2x(1, 4, "WELCOME");
    oled_draw_string_2x(3, 22, "TO");
    oled_draw_string_2x(5, 34, "COCIS");
}

void oled_show_access(uint32_t tag, bool is_entry, const char* result) {
    oled_clear();
    bool granted = (strstr(result, "OK") != NULL);
    
    char tag_str[20];
    snprintf(tag_str, sizeof(tag_str), "%s %08lX", is_entry ? "IN " : "OUT", (unsigned long)tag);
    
    // Using 2x font for the access screen
    if (granted) {
        oled_draw_string_2x(1, 5, "GRANTED");
        oled_draw_string_2x(3, 0, tag_str);
    } else {
        oled_draw_string_2x(1, 10, "DENIED");
        oled_draw_string_2x(3, 0, tag_str);
    }
}